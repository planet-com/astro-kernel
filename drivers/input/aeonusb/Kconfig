## drivers/input/aeonusb/Kconfig
```kconfig
config AEON_USB_SWITCH
	tristate "AEON USB SWITCH Support"
	default n
	help
	  Say Y here if you have Eastaeon uswitch device.
	  If unsure, say Y.
```

## drivers/input/fingerprint/Kconfig
```kconfig
#
#Fingerprint
#
menu "Fingerprint support"
	depends on INPUT

config MTK_FINGERPRINT_SUPPORT
	bool "Mediatek Fingerprint"
	default n
	help
	  Fingerprint mtk driver enable/disable
	  in the kernel.Say Y here if you want to
	  use mediatek fingerprint driver,fingerprint
	  driver will support fingerprint function

config CDFINGERPRINT_FP
    bool "cd Fingerprint fp"
    default n
    ---help---
    cd fingerprint chip.	  
	  
config MTK_FINGERPRINT_SELECT
	string "sensor type"
	default "NA"


endmenu
config MTK_SIMSWAP_AW6302
        tristate "aw6302_driver"
        default y
        help
           aw6302_driver
source "drivers/input/fingerprint/aw6302_driver/Kconfig"
```

## drivers/input/fingerprint/aw6302_driver/Kconfig
```kconfig
config MTK_SIMSWAP_AW6302
	bool "MTK_SIMSWAP_AW6302"
	default n
	help
		mtk_simswap_aw6302
```

## drivers/input/functionkey/Kconfig
```kconfig
config MTK_FUNCTION_KEY
	tristate "MTK FUNCTION KEY Support"
	default n
	help
	  Say Y here if you have Eastaeon key device.
	  If unsure, say Y.
```

## drivers/input/key/Kconfig
```kconfig
config MTK_KEY
	tristate "MTK KEY Support"
	default n
	help
	  Say Y here if you have Eastaeon key device.
	  If unsure, say Y.
```

## drivers/input/touchscreen/GT9897/Kconfig
```kconfig
#
# Goodix touchscreen driver configuration
#
menuconfig TOUCHSCREEN_GOODIX_BRL
	tristate "Goodix berlin touchscreen"
	help
	  Say Y here if you have a Goodix berlin series touch controller
	  to your system.

	  If unsure, say N.

config GOODIX_BRL_I2C
	tristate "support I2C bus connection"
	depends on I2C
	default y
	help
	  Say Y here if the touchscreen is connected via I2C bus.

	  To compile this driver as a module, choose M here.

config GOODIX_BRL_SPI
	tristate "support SPI bus connection"
	depends on SPI_MASTER
	help
	  Say Y here if the touchscreen is connected via SPI bus.

	  To compile this driver as a module, choose M here.

config GOODIX_BRL_TOOLS
	tristate "Goodix debug tools support"
	default y
	help
	  Say Y here to enable debug tools.

	  If unsure, say N.

	  To compile this driver as a module, choose M here.

config GOODIX_BRL_GESTURE
	tristate "Goodix gesture support"
	help
	  Say Y here to enable gesture.

	  If unsure, say N.

	  To compile this driver as a module, choose M here.

config GOODIX_BRL_INSPECT
	tristate "Goodix inspect support"
	help
	  Say Y here to enable inspect.

	  If unsure, say N.

	  To compile this driver as a module, choose M here.
	  
endmenu
```

## drivers/input/touchscreen/touch_8789p1_8185p3/8185p3_8789p1/Kconfig
```kconfig
#
# Himax Touchscreen driver configuration
#

config TOUCHSCREEN_HIMAX_I2C
        bool "HIMAX chipset i2c touchscreen"
	help
	  This enables support for HIMAX CHIPSET over I2C based touchscreens.
	  when turn this option on, TOUCHSCREEN_HIMAX_I2C touch driver
	  will open.
	  If unsure,say N.

config TOUCHSCREEN_HIMAX_COMMON
        bool "HIMAX chipset common touchscreen"
	depends on TOUCHSCREEN_HIMAX_CHIPSET
	help
	  Say Y here to enable support for I2C based touchscreens.
	  To compile this driver as a module, choose M here: the
	  module will be called HimaxChipsetTs.

config TOUCHSCREEN_HIMAX_INCELL
        bool "HIMAX chipset in-cell function"
	depends on TOUCHSCREEN_HIMAX_COMMON
	help
	  if you want to use on-cell function, you must set the config.
	  If unsure, not set it.
	  there are some on-cell function in the code of Himax touch.
	  choose the config here to support for the on-cell function.

config TOUCHSCREEN_HIMAX_IC_HX852xH
        tristate "HIMAX chipset HX852xH function"
	depends on TOUCHSCREEN_HIMAX_ONCELL
	help
	  if you want to use HIMAX CHIPSET of HX852xH, you should set the config.
	  If unsure, not set it.
	  if you want to compile this driver as a module, choose M here.
	  choose the config here to support for the HX852xH.

config TOUCHSCREEN_HIMAX_IC_HX852xG
        tristate "HIMAX chipset HX852xG function"
	depends on TOUCHSCREEN_HIMAX_ONCELL
	help
	  if you want to use HIMAX CHIPSET of HX852xG, you should set the config.
	  If unsure, not set it.
	  if you want to compile this driver as a module, choose M here.
	  choose the config here to support for the HX852xG.

config TOUCHSCREEN_HIMAX_IC_HX83192
        tristate "HIMAX chipset HX83192 function"
	depends on TOUCHSCREEN_HIMAX_INCELL
	help
	  if you want to use HIMAX CHIPSET of HX83192, you should set the config.
	  If unsure, not set it.
	  if you want to compile this driver as a module, choose M here.
	  choose the config here to support for the HX83192.

config TOUCHSCREEN_HIMAX_IC_HX83191
        tristate "HIMAX chipset HX83191 function"
	depends on TOUCHSCREEN_HIMAX_INCELL
	help
	  if you want to use HIMAX CHIPSET of HX83191, you should set the config.
	  If unsure, not set it.
	  if you want to compile this driver as a module, choose M here.
	  choose the config here to support for the HX83191.

config TOUCHSCREEN_HIMAX_IC_HX83113
        tristate "HIMAX chipset HX83113 function"
	depends on TOUCHSCREEN_HIMAX_INCELL
	help
	  if you want to use HIMAX CHIPSET of HX83113, you should set the config.
	  If unsure, not set it.
	  if you want to compile this driver as a module, choose M here.
	  choose the config here to support for the HX83113.

config TOUCHSCREEN_HIMAX_IC_HX83112
        tristate "HIMAX chipset HX83112 function"
	depends on TOUCHSCREEN_HIMAX_INCELL
	help
	  if you want to use HIMAX CHIPSET of HX83112, you should set the config.
	  If unsure, not set it.
	  if you want to compile this driver as a module, choose M here.
	  choose the config here to support for the HX83112.

config TOUCHSCREEN_HIMAX_IC_HX83111
        tristate "HIMAX chipset HX83111 function"
	depends on TOUCHSCREEN_HIMAX_INCELL
	help
	  if you want to use HIMAX CHIPSET of HX83111, you should set the config.
	  If unsure, not set it.
	  if you want to compile this driver as a module, choose M here.
	  choose the config here to support for the HX83111.

config TOUCHSCREEN_HIMAX_IC_HX83106
        tristate "HIMAX chipset HX83106 function"
	depends on TOUCHSCREEN_HIMAX_INCELL
	help
	  if you want to use HIMAX CHIPSET of HX83106, you should set the config.
	  If unsure, not set it.
	  if you want to compile this driver as a module, choose M here.
	  choose the config here to support for the HX83106.

config TOUCHSCREEN_HIMAX_IC_HX83103
        tristate "HIMAX chipset HX83103 function"
	depends on TOUCHSCREEN_HIMAX_INCELL
	help
	  if you want to use HIMAX CHIPSET of HX83103, you should set the config.
	  If unsure, not set it.
	  if you want to compile this driver as a module, choose M here.
	  choose the config here to support for the HX83103.

config TOUCHSCREEN_HIMAX_IC_HX83102
        tristate "HIMAX chipset HX83102 function"
	depends on TOUCHSCREEN_HIMAX_INCELL
	help
	  if you want to use HIMAX CHIPSET of HX83102, you should set the config.
	  If unsure, not set it.
	  if you want to compile this driver as a module, choose M here.
	  choose the config here to support for the HX83102.

config TOUCHSCREEN_HIMAX_DEBUG
        bool "HIMAX debug function"
	help
	  This enables support for HIMAX debug function.
	  when turn this option on, driver will open some debug function.
	  will open.
	  If unsure,say N.

config TOUCHSCREEN_HIMAX_INSPECT
        bool "HIMAX inspect function"
	depends on TOUCHSCREEN_HIMAX_INCELL || TOUCHSCREEN_HIMAX_ONCELL
	help
	  if you want to use HIMAX debug function of HMIAX TOUCH driver,
	  you should set the config.

	  If unsure, not set it.

	  choose the config here to support for the HIMAX debug function.

config TOUCHSCREEN_HIMAX_EMBEDDED_FIRMWARE
	bool "HIMAX embedded firmware function"
	depends on TOUCHSCREEN_HIMAX_INCELL || TOUCHSCREEN_HIMAX_ONCELL
	help
	  if you want to enable built-in FW inside kernel as binary array,
	  you should set the config.
	  If unsure, not set it.
	  This enables built-in FW inside kernel as binary array

config HMX_DB
	bool "HIMAX driver test over Dragon Board"
	depends on TOUCHSCREEN_HIMAX_COMMON
	help
	  This enables support for HIMAX driver test over Dragon Board.
```

## drivers/input/touchscreen/touch_8789p1_8185p3/Kconfig
```kconfig
#
# Touchscreen driver configuration
#
menuconfig TOUCHSCREEN_8789P1_8185P3
	bool "Touchscreens_8789P1_8185P3"
	help
	  Say Y here, and a list of supported touchscreens will be displayed.
	  This option doesn't affect the kernel.

	  If unsure, say Y.

if TOUCHSCREEN_8789P1_8185P3

config TOUCHSCREEN_PHYSICAL_ROTATION_WITH_LCM
	bool "MediaTek Touch Panel Rotation With LCM"
	default y
	help
	  Say N here if touch panel is not physical rotated as LCM does.
	  Physically rotated means that this driver will map
	  the reported coordination to diagonal position.

	  If unsure, say Y.

	  If unsure, say N.

	  To compile this dirver as a module, choose M here: the
	  module will be called.

source "drivers/input/touchscreen/touch_8789p1_8185p3/8185p3_8789p1/Kconfig"

endif
```

## drivers/input/uswitch/Kconfig
```kconfig
config USB_CHARGING_SWITCH
	tristate "MTK USWITCH Support"
	default n
	help
	  Say Y here if you have Eastaeon uswitch device.
	  If unsure, say Y.
```

## drivers/misc/mediatek/gpio/Kconfig
```kconfig
config MTK_GPIO
	tristate "MediaTek GPIO driver"
	default y
	---help---
	  This selects the MediaTek(R) GPIO driver.
	  Some pinctrl functions need the utilities from this driver.
	  If you want to use MediaTek(R) GPIO driver, say Y or M here.
	  If unsure, say N.
```
